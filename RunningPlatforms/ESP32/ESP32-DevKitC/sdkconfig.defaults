## RunningPlatforms/ESP32/ESP32-DevKitC/sdkconfig.defaults
```kconfig
#
# ESP System Settings
#
# CONFIG_ESP_DEFAULT_CPU_FREQ_MHZ_80 is not set
# CONFIG_ESP_DEFAULT_CPU_FREQ_MHZ_160 is not set
CONFIG_ESP_DEFAULT_CPU_FREQ_MHZ_240=y
CONFIG_ESP_DEFAULT_CPU_FREQ_MHZ=240

#
# FreeRTOS Kernel
#
CONFIG_FREERTOS_HZ=1000

#
# Partition Table
#
CONFIG_PARTITION_TABLE_OFFSET=0x9000
```
